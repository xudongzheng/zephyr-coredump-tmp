## prj.conf
```kconfig
CONFIG_USE_SEGGER_RTT=y
CONFIG_DEBUG=y
CONFIG_SEGGER_RTT_BUFFER_SIZE_UP=4096
CONFIG_ASSERT=y
CONFIG_CONSOLE=y
CONFIG_RTT_CONSOLE=y
CONFIG_LOG=y
CONFIG_LOG_BUFFER_SIZE=4096
CONFIG_LOG_PROCESS_THREAD_SLEEP_MS=100

CONFIG_BOARD_HAS_NRF5_BOOTLOADER=n
CONFIG_DEBUG_COREDUMP=y
CONFIG_DEBUG_COREDUMP_MEMORY_DUMP_MIN=y
```

## src/main.c
```c
#include <zephyr/kernel.h>
#include <zephyr/logging/log.h>

LOG_MODULE_REGISTER(app);

static void my_timer_handler(struct k_timer *dummy) {
	k_panic();
}

K_TIMER_DEFINE(my_timer, my_timer_handler, NULL);

void main(void) {
	LOG_ERR("boot");
	k_timer_start(&my_timer, K_SECONDS(7), K_FOREVER);
}
```
